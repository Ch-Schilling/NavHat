/*
 * Device Tree overlay for NavHat describing 5A drive capability
 */

/dts-v1/;
/plugin/;

/ {
	compatible = "brcm,bcm2712";

	fragment@0 {
		target-path = "/chosen";
		__overlay__ {
			power: power {
				hat_current_supply = <5000>;
			};
		};
	};
};
